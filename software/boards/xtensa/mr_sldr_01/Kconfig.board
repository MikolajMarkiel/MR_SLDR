## software/boards/xtensa/mr_sldr_01/Kconfig.board
```kconfig
# MR_SLDR_01 board configuration

# Copyright (c) 2017 Intel Corporation
# SPDX-License-Identifier: Apache-2.0

config BOARD_MR_SLDR_01
	bool "MR_SLDR_01 Development Board"
	depends on SOC_ESP32 # TODO check if there shouldn't be 'select' like in last project
	# select SOC_ESP32
```

## software/boards/xtensa/mr_sldr_01/Kconfig.defconfig
```kconfig
# MR_SLDR_01 board configuration

# Copyright (c) 2017 Intel Corporation
# SPDX-License-Identifier: Apache-2.0

config BOARD
	default "mr_sldr_01"
	depends on BOARD_MR_SLDR_01

# config ENTROPY_GENERATOR // TODO remove?
# 	default y

config HEAP_MEM_POOL_SIZE
	default 98304 if WIFI
	default 40960 if BT
	default 4096

choice BT_HCI_BUS_TYPE
	default BT_ESP32 if BT
endchoice
```
